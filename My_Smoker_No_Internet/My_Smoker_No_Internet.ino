//No wifi or ethernet
//GRIND SMOKER CONTROLLER REV B

#include <LCD.h>
#include <LiquidCrystal_I2C.h>
#include <max6675.h>

//Must matxh HEX address with screen
LiquidCrystal_I2C lcd(0x27, 2, 1, 0, 4, 5, 6, 7, 3, POSITIVE);

#define oven_sck A0
#define oven_cs A1
#define oven_so A2

#define meat_sck A3
#define meat_cs A4
#define meat_so A5

#define upButton 9
#define downButton 8

int ovenRelay = 5;

int upTemp = 0;
int downTemp = 0;
int setTemp = 250;

int oventemp = 0;
int meattemp = 0;

MAX6675 ovenTemp(oven_sck, oven_cs, oven_so);
MAX6675 meatTemp(meat_sck, meat_cs, meat_so);

const char custom[][8] PROGMEM = {                        // Custom character definitions
  { 0x1F, 0x1F, 0x1F, 0x00, 0x00, 0x00, 0x00, 0x00 }, // char 1
  { 0x18, 0x1C, 0x1E, 0x1F, 0x1F, 0x1F, 0x1F, 0x1F }, // char 2
  { 0x1F, 0x1F, 0x1F, 0x1F, 0x1F, 0x0F, 0x07, 0x03 }, // char 3
  { 0x00, 0x00, 0x00, 0x00, 0x00, 0x1F, 0x1F, 0x1F }, // char 4
  { 0x1F, 0x1F, 0x1F, 0x1F, 0x1F, 0x1E, 0x1C, 0x18 }, // char 5
  { 0x1F, 0x1F, 0x1F, 0x00, 0x00, 0x00, 0x1F, 0x1F }, // char 6
  { 0x1F, 0x00, 0x00, 0x00, 0x00, 0x1F, 0x1F, 0x1F }, // char 7
  { 0x03, 0x07, 0x0F, 0x1F, 0x1F, 0x1F, 0x1F, 0x1F }  // char 8
};

const char bigChars[][8] PROGMEM = {
  { 0x20, 0x20, 0x00, 0x00, 0x00, 0x00, 0x00, 0x00 }, // Space
  { 0xFF, 0x07, 0x00, 0x00, 0x00, 0x00, 0x00, 0x00 }, // !
  { 0x05, 0x05, 0x20, 0x20, 0x00, 0x00, 0x00, 0x00 }, // "
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  { 0x20, 0x20, 0x20, 0x04, 0x04, 0x04, 0x00, 0x00 }  // _
};
byte col, row, nb = 0, bc = 0;                            // general
byte bb[8];

void setup() {
  lcd.begin (20, 4);

  for (nb = 0; nb < 8; nb++ ) {                 // create 8 custom characters
    for (bc = 0; bc < 8; bc++) bb[bc] = pgm_read_byte( &custom[nb][bc] );
    lcd.createChar ( nb + 1, bb );
  }
  lcd.clear();
  writeBigString("G R I N D", 0, 0);
  lcd.setCursor(5, 2);
  lcd.print("ENGINEERING");
  lcd.setCursor(5, 3);
  lcd.print("[EST: 2018]");
  delay(3000);
  lcd.clear();
  writeBigString("JEFF'S", 3, 0);
  writeBigString("SMOKER", 0, 2);
  delay(3000);
  lcd.clear();

  pinMode(ovenRelay, OUTPUT);
  pinMode(upButton, INPUT_PULLUP);
  pinMode(downButton, INPUT_PULLUP);


  digitalWrite(ovenRelay, LOW);

  lcd.setCursor(0, 0);
  lcd.print("   Set Temp: ");

  lcd.setCursor(2, 1);
  lcd.print("Oven Temp: ");

  lcd.setCursor(2, 2);
  lcd.print("Meat Temp: ");

  lcd.setCursor(5, 3);
  lcd.print("Heat On:");
}

void loop() {
  //Temperature read-------------------
  oventemp = ovenTemp.readFarenheit();
  meattemp = meatTemp.readFarenheit();

  //Relay Control---------------------
  if (oventemp < setTemp - 2) {
    digitalWrite(ovenRelay, LOW);
    lcd.setCursor(13, 3);
    lcd.print((char) 255);
  }
  if (oventemp >= setTemp) {
    digitalWrite(ovenRelay, HIGH);
    lcd.setCursor(13, 3);
    lcd.print(" ");
  }

  //Temperature set--------------------
  upTemp = digitalRead(upButton);
  downTemp = digitalRead(downButton);

  if (upTemp == LOW) {
    setTemp = setTemp + 5;
    lcd.setCursor(13, 0);
    lcd.print(setTemp);
  }
  if (downTemp == LOW) {
    setTemp = setTemp - 5;
    lcd.setCursor(13, 0);
    lcd.print(setTemp);
  }
  lcd.setCursor(13, 0);
  lcd.print(setTemp);
  if (setTemp < 100) {
    lcd.setCursor(15, 0);
    lcd.print(" ");
  }
  lcd.setCursor(16, 0);
  lcd.print((char)223);
  lcd.print("F");

  //Oven Temp print----------------------
  lcd.setCursor(13, 1);
  lcd.print(oventemp);
  if (oventemp < 100) {
    lcd.setCursor(15, 1);
    lcd.print(" ");
  }
  lcd.setCursor(16, 1);
  lcd.print((char)223);
  lcd.print("F");
  delay(300);

  //Meat Temp print----------------------
  lcd.setCursor(13, 2);
  lcd.print(meattemp);
  if (meattemp < 100) {
    lcd.setCursor(15, 2);
    lcd.print(" ");
  }
  lcd.setCursor(16, 2);
  lcd.print((char)223);
  lcd.print("F");
  delay(300);
}
// ********************************************************************************** //
// writeBigChar: writes big character 'ch' to column x, row y; returns number of columns used by 'ch'
int writeBigChar(char ch, byte x, byte y) {
  if (ch < ' ' || ch > '_') return 0;               // If outside table range, do nothing
  nb = 0;                                           // character byte counter
  for (bc = 0; bc < 8; bc++) {
    bb[bc] = pgm_read_byte( &bigChars[ch - ' '][bc] ); // read 8 bytes from PROGMEM
    if (bb[bc] != 0) nb++;
  }

  bc = 0;
  for (row = y; row < y + 2; row++) {
    for (col = x; col < x + nb / 2; col++ ) {
      lcd.setCursor(col, row);                      // move to position
      lcd.write(bb[bc++]);                          // write byte and increment to next
    }
    //    lcd.setCursor(col, row);
    //    lcd.write(' ');                                 // Write ' ' between letters
  }
  return nb / 2 - 1;                                  // returns number of columns used by char
}

// writeBigString: writes out each letter of string
void writeBigString(char *str, byte x, byte y) {
  char c;
  while ((c = *str++))
    x += writeBigChar(c, x, y) + 1;
}
